## CMakeLists.txt
```
# SPDX-License-Identifier: Apache-2.0

cmake_minimum_required(VERSION 3.20.0)
set(CMAKE_CXX_STANDARD 17)
find_package(Zephyr REQUIRED HINTS $ENV{ZEPHYR_BASE})
project(test_dji)

FILE(GLOB app_sources src/*.c)

include_directories(${ZEPHYR_BASE}/include)
include_directories(${CMAKE_CURRENT_SOURCE_DIR}/include)
include_directories(${CMAKE_CURRENT_SOURCE_DIR}/dts)
target_sources(app PRIVATE ${app_sources})
target_include_directories(app PRIVATE ${ZEPHYR_BASE}/include)
target_include_directories(app PRIVATE ${CMAKE_CURRENT_SOURCE_DIR}/include)
target_include_directories(app PRIVATE ${CMAKE_CURRENT_SOURCE_DIR}/dts)
```

## prj.conf
```kconfig
#启用线程分析器
CONFIG_THREAD_ANALYZER=y
CONFIG_THREAD_ANALYZER_USE_LOG=y
CONFIG_THREAD_ANALYZER_USE_PRINTK=n
CONFIG_THREAD_NAME=y

# 启用串行支持
CONFIG_SERIAL=y
CONFIG_SPI_ASYNC=y

# 启用驱动
CONFIG_MOTOR=y
CONFIG_MOTOR_DJI=y
# CONFIG_MOTOR_MI=y
CONFIG_MOTOR_LOG_LEVEL=4
CONFIG_CAN=y
CONFIG_MOTOR_INIT_PRIORITY=90
CONFIG_PID=y

CONFIG_ARES=y
CONFIG_ARES_SBUS=y
CONFIG_SBUS_INIT_PRIORITY=90

# use ASYNC uart API
CONFIG_SERIAL=y
CONFIG_UART_ASYNC_API=y
CONFIG_UART_INTERRUPT_DRIVEN=y

CONFIG_DMA=y
CONFIG_DMA_STM32=y  # STM32 DMA 驱动
CONFIG_UART_STM32=y # STM32 UART 驱动
# CONFIG_STM32_UART_DMA=y

# CONFIG_HAS_STM32CUBE=y
# CONFIG_USE_STM32_HAL_DMA=y
# CONFIG_SPI=y
# CONFIG_SPI_STM32=y

#
# Device Drivers
#
# CONFIG_SENSOR=y
# CONFIG_BMI08X=y
# CONFIG_BMI08X_ACCEL_TRIGGER_NONE is not set
# CONFIG_BMI08X_ACCEL_TRIGGER_GLOBAL_THREAD=y
# CONFIG_BMI08X_ACCEL_TRIGGER_OWN_THREAD is not set
# CONFIG_BMI08X_GYRO_TRIGGER_NONE is not set
# CONFIG_BMI08X_GYRO_TRIGGER_GLOBAL_THREAD=y
# CONFIG_BMI08X_GYRO_TRIGGER_OWN_THREAD is not set
# CONFIG_BMI08X_I2C_WRITE_BURST_SIZE=16


# USB相关配置
CONFIG_DUAL_PROPOSE_PROTOCOL=y
CONFIG_USB_BULK_INTERFACE=y

CONFIG_UDC_DRIVER_LOG_LEVEL_WRN=y
CONFIG_USBD_LOG_LEVEL_WRN=y

CONFIG_USBD_MAX_UDC_MSG=24
CONFIG_USBD_MSG_SLAB_COUNT=24
CONFIG_UDC_BUF_COUNT=128
CONFIG_UDC_WORKQUEUE=y
CONFIG_UDC_WORKQUEUE_PRIORITY=0
CONFIG_UDC_BUF_POOL_SIZE=4096
```

## boards/robomaster_board_c.overlay
```dts
&cdc_acm_uart0 {
	status = "disabled";
};
```

## src/main.c
```c
#include "ares/board/init.h"
#include "ares/ares_comm.h"
#include <math.h>
#include <stddef.h>
#include <stdint.h>
#include <stdio.h>
#include <zephyr/debug/thread_analyzer.h>
#include <zephyr/device.h>
#include <zephyr/devicetree.h>
#include <zephyr/drivers/can.h>
#include <zephyr/drivers/motor.h>
#include <zephyr/drivers/sbus.h>
#include <zephyr/drivers/sensor.h>
#include <zephyr/drivers/uart.h>
#include <zephyr/kernel.h>
#include <zephyr/logging/log.h>
#include <zephyr/sys/printk.h>


LOG_MODULE_REGISTER(main, LOG_LEVEL_DBG);

#define G 9.80665f

#define HIGH_BYTE(x) ((x) >> 8)
#define LOW_BYTE(x) ((x)&0xFF)
#define COMBINE_HL8(HIGH, LOW) ((HIGH << 8) + LOW)

static sync_table_t *pack_tx = NULL;
static sync_table_t *pack_rx = NULL;
static sync_table_t *speed_tx = NULL;
static sync_table_t *imu_tx = NULL;

float motor_parameter_pack[9] = {90.0f,45.0f,-45.0f,-90.0f,-90.0f,-45.0f,45.0f,90.0f,30.0f};
/* 周期性通过 pack_tx 向 PC 发送 9 路电机参数；PC 通过 0x0101 帧发来目标角度 */
float motor_cmd_buffer[9] = {0};  // 接收命令的缓冲区
float motor_speed_pack[9] = {
  120.5f,   // 电机1速度
  -85.2f,   // 电机2速度 
  200.0f,   // 电机3速度
  -150.8f,  // 电机4速度
  95.3f,    // 电机5速度
  -45.6f,   // 电机6速度
  180.2f,   // 电机7速度
  -75.4f,   // 电机8速度
  110.9f    // 电机9速度
};

float imu_pack[7] = {
  1.0f,     // 四元数q0 (w)
  0.0f,     // 四元数q1 (x)
  0.0f,     // 四元数q2 (y)
  0.0f,     // 四元数q3 (z)
  0.15f,    // 角速度X (rad/s)
  -0.08f,   // 角速度Y (rad/s)
  0.25f     // 角速度Z (rad/s)
};

void tx_cb(int status)
{
    if (status == SYNC_PACK_STATUS_READ) {
        LOG_DBG("Motor state data sent to PC successfully!");
    } else if (status == SYNC_PACK_STATUS_WRITE) {
        LOG_DBG("Motor state data received from PC!");
    }
}

void rx_cb(int status)
{
    if (status == SYNC_PACK_STATUS_WRITE) {
        LOG_INF("Motor commands received from PC:");
        for (int i = 0; i < 9; ++i) {
            LOG_INF("motor[%d] = %.2f", i, motor_cmd_buffer[i]);
            // 这里可以添加电机控制逻辑
            // motor_set_angle(motors[i], motor_cmd_buffer[i]);
        }
    } else if (status == SYNC_PACK_STATUS_READ) {
        LOG_DBG("Motor command request sent to PC!");
    }
}

DUAL_PROPOSE_PROTOCOL_DEFINE(dual_protocol);
ARES_BULK_INTERFACE_DEFINE(usb_bulk_interface);
int main(void) 
{
  ares_bind_interface(&usb_bulk_interface, &dual_protocol);
  /*
   * 0x0201 : MCU -> Host  (MotorState-A)
   * 0x0101 : Host -> MCU  (MotorCmd)
   */
  pack_tx = dual_sync_add(&dual_protocol, 0x0201, (uint8_t *)motor_parameter_pack, 36, tx_cb);
  pack_rx = dual_sync_add(&dual_protocol, 0x0101, (uint8_t *)motor_cmd_buffer, 36, rx_cb);
  speed_tx = dual_sync_add(&dual_protocol, 0x0202, (uint8_t *)motor_speed_pack, 36, tx_cb);
  imu_tx = dual_sync_add(&dual_protocol, 0x0301, (uint8_t *)imu_pack, 28, tx_cb);

  LOG_INF("USB transfer initialized and sync pack created!");
  while (1) {
    /* 将当前 motor_parameter_pack 内容推送给上位机，20 ms 一次 */
    dual_sync_flush(&dual_protocol, pack_tx);
    k_msleep(2);
    dual_sync_flush(&dual_protocol, speed_tx);
    k_msleep(2);
    dual_sync_flush(&dual_protocol, imu_tx);
    k_msleep(2);
  }
}
```
