## CMakeLists.txt
```
# SPDX-License-Identifier: Apache-2.0

cmake_minimum_required(VERSION 3.20.0)
set(CMAKE_CXX_STANDARD 17)
find_package(Zephyr REQUIRED HINTS $ENV{ZEPHYR_BASE})
project(sbus)

FILE(GLOB app_sources src/*.c)

include_directories(${ZEPHYR_BASE}/include)
include_directories(${CMAKE_CURRENT_SOURCE_DIR}/include)
include_directories(${CMAKE_CURRENT_SOURCE_DIR}/dts)
target_sources(app PRIVATE ${app_sources})
target_include_directories(app PRIVATE ${ZEPHYR_BASE}/include)
target_include_directories(app PRIVATE ${CMAKE_CURRENT_SOURCE_DIR}/include)
target_include_directories(app PRIVATE ${CMAKE_CURRENT_SOURCE_DIR}/dts)
```

## prj.conf
```kconfig
# 启用串行支持
CONFIG_SERIAL=y

# 启用日志系统
CONFIG_LOG=y
CONFIG_LOG_PRINTK=y
CONFIG_LOG_BACKEND_UART=y
CONFIG_LOG_MODE_IMMEDIATE=y

# 启用 UART 控制台
CONFIG_UART_CONSOLE=y

# 启用控制台支持
CONFIG_CONSOLE=y

CONFIG_UART_ASYNC_API=y
CONFIG_UART_INTERRUPT_DRIVEN=y

CONFIG_DMA=y
CONFIG_DMA_STM32=y  # STM32 DMA 驱动
CONFIG_UART_STM32=y # STM32 UART 驱动

#启用遥控器
CONFIG_ARES=y
CONFIG_ARES_SBUS=y

CONFIG_NO_OPTIMIZATIONS=y

# 启用线程分析器
CONFIG_THREAD_ANALYZER=y
CONFIG_THREAD_ANALYZER_USE_LOG=y
CONFIG_THREAD_ANALYZER_USE_PRINTK=n
CONFIG_THREAD_NAME=y
# CONFIG_THREAD_ANALYZER_AUTO=y
# CONFIG_THREAD_ANALYZER_AUTO_INTERVAL=5
CONFIG_THREAD_ANALYZER_LOG_LEVEL_INF=y
CONFIG_THREAD_ANALYZER_AUTO_SEPARATE_CORES=n
```

## boards/robomaster_board_c.overlay
```dts
/ {
    sbus0: sbus0 {
        compatible = "ares,sbus";
        status = "okay";
    };
};
```

## src/main.c
```c
#include <math.h>
#include <stdint.h>
#include <zephyr/device.h>
#include <zephyr/devicetree.h>
#include <zephyr/drivers/sbus.h>
#include <zephyr/zbus/zbus.h>
#include <zephyr/drivers/uart.h>
#include <zephyr/kernel.h>
#include <zephyr/logging/log.h>
#include <zephyr/sys/printk.h>
#include <zephyr/debug/thread_analyzer.h>

LOG_MODULE_REGISTER(main, LOG_LEVEL_DBG);

#define SBUS_NODE DT_NODELABEL(sbus0)

int main()
{
    const struct device *sbus = DEVICE_DT_GET(SBUS_NODE);

    if (!device_is_ready(sbus)) {
        LOG_ERR("SBUS device not ready");
        return 0;
    }

    uint8_t channel = 5; 
    float percent = 0; 
    int digital = 0; 

    LOG_INF("Channel %d: percent = %f, digital = %d", channel, percent, digital);

    while (1) {
        percent = sbus_get_percent(sbus, channel);
        digital = sbus_get_digit(sbus, channel);

        LOG_INF("Channel %d: percent = %f, digital = %d", channel, percent, digital);
        k_msleep(500);
    }

    return 0;
}
```
